## conf/layer.conf
```bitbake
# We have a conf and classes directory, append to BBPATH
BBPATH .= ":${LAYERDIR}"

# We have a recipes directory, add to BBFILES
BBFILES += "${LAYERDIR}/recipes*/*/*.bb ${LAYERDIR}/recipes*/*/*.bbappend"

BBFILE_COLLECTIONS += "stm32mp1-bsp-base"
BBFILE_PATTERN_stm32mp1-bsp-base := "^${LAYERDIR}/"
BBFILE_PRIORITY_stm32mp1-bsp-base = "7"
LAYERSERIES_COMPAT_stm32mp1-bsp-base = "thud dunfell"
```

## conf/local.conf
```bitbake
# Common configuration for all Machine types
AUTHOR = "Dimitris Tassopoulos"
MACHINE ?= "stm32mp1"
DISTRO ?= "poky"

PACKAGE_CLASSES ?= " package_deb"
USER_CLASSES = "buildstats image-mklibs image-prelink"
CONF_VERSION = "1"

INHERIT += " rm_work"
# For debugging u-boot and kernel
RM_WORK_EXCLUDE += " linux-stable u-boot"

DISTRO_FEATURES_append = " systemd"
VIRTUAL-RUNTIME_init_manager = "systemd"
DISTRO_FEATURES_BACKFILL_CONSIDERED = "sysvinit"

# BB_GENERATE_MIRROR_TARBALLS = "1"

DL_DIR ?= "${BSPDIR}/downloads/"
TMPDIR ?= "${TOPDIR}/tmp"

SDKMACHINE = "x86_64"
## It's a known issue that when you build the SDK using `-c populate_sdk`
# then there are a few packages that conflict with recipes like:
# poky/meta/recipes-core/meta/target-sdk-provides-dummy.bb
# Therefore, in this case we need to remove those packages from out image build.
REMOVE_SDK_CONFLICT_PKGS = "0"

PREFERRED_PROVIDER_virtual/kernel = "linux-stm32mp"

PREFERRED_PROVIDER_virtual/bootloader = "u-boot-stm32mp"
PREFERRED_PROVIDER_u-boot = "u-boot-stm32mp"

# Extra host tools that are used in this BSP
HOSTTOOLS += "lsdiff"

ACCEPT_EULA_stm32mp1-discotest = "1"

# Add your custom config under this line
```
